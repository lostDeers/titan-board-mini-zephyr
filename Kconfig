## Kconfig
```kconfig
# SPDX-License-Identifier: Apache-2.0

menu "Titan Board Mini workspace"

rsource "src/drivers/video/renesas_ra_mipi/Kconfig"

endmenu
```

## src/boards/rt-thread/titan_board_mini/Kconfig.titan_board_mini
```kconfig
# Copyright (c) 2026 RT-Thread
# SPDX-License-Identifier: Apache-2.0

config BOARD_TITAN_BOARD_MINI
	select SOC_R7KA8P1KFLCAC_CM85 if BOARD_TITAN_BOARD_MINI_R7KA8P1KFLCAC_CM85
	select SOC_R7KA8P1KFLCAC_CM33 if BOARD_TITAN_BOARD_MINI_R7KA8P1KFLCAC_CM33

config TITAN_BOARD_MINI_OV5640_XCLK
	bool "Start OV5640 camera XCLK from GPT11B"
	depends on VIDEO && PWM && CLOCK_CONTROL && CLOCK_CONTROL_PWM
	help
	  Start the Titan Board Mini OV5640 external clock before video sensor
	  drivers initialize. The camera connector routes this clock through
	  GPT11B on P5.00; the probe overlay selects the generated frequency.

config TITAN_BOARD_MINI_OV5640_XCLK_INIT_PRIORITY
	int "OV5640 camera XCLK init priority"
	default 55
	depends on TITAN_BOARD_MINI_OV5640_XCLK
	help
	  Must run after the pwm-clock device and before CONFIG_VIDEO_INIT_PRIORITY.
```

## src/boards/rt-thread/titan_board_mini/board.yml
```yaml
board:
  name: titan_board_mini
  full_name: Titan Board Mini
  vendor: rt-thread
  socs:
  - name: r7ka8p1kflcac
```

## src/boards/rt-thread/titan_board_mini/titan_board_mini_r7ka8p1kflcac_cm33_defconfig
```kconfig
# Copyright (c) 2026 RT-Thread
# SPDX-License-Identifier: Apache-2.0

# Enable GPIO
CONFIG_GPIO=y

# Enable Console
CONFIG_SERIAL=y
CONFIG_CONSOLE=y
```

## src/boards/rt-thread/titan_board_mini/titan_board_mini_r7ka8p1kflcac_cm85_defconfig
```kconfig
# Copyright (c) 2026 RT-Thread
# SPDX-License-Identifier: Apache-2.0

# Enable GPIO
CONFIG_GPIO=y

# Enable Console
CONFIG_SERIAL=y
CONFIG_UART_CONSOLE=y
CONFIG_UART_INTERRUPT_DRIVEN=y
CONFIG_CONSOLE=y

# Enable I2C
CONFIG_I2C=y

# Enable SPI
CONFIG_SPI=y

# Enable RTC
CONFIG_RTC=y

# Enable Watchdog
CONFIG_WATCHDOG=y

# Enable Ethernet networking
CONFIG_NETWORKING=y

# Enable SDHC
CONFIG_SDHC=y

# Enable USB device
CONFIG_USB_DEVICE_STACK=y

# Enable Input (buttons)
CONFIG_INPUT=y

# Enable HW Info
CONFIG_HWINFO=y
```

## src/drivers/flash/Kconfig
```kconfig
# SPDX-License-Identifier: Apache-2.0

menu "W25Q64 flash drivers"

config TITAN_W25Q64_RA_OSPI_B
	bool "Titan Board Mini W25Q64 over RA OSPI_B"
	default y
	depends on FLASH
	depends on DT_HAS_TITAN_W25Q64_RA_OSPI_B_ENABLED
	select FLASH_HAS_DRIVER_ENABLED
	select FLASH_HAS_PAGE_LAYOUT
	select FLASH_HAS_EXPLICIT_ERASE
	select FLASH_JESD216
	select FLASH_HAS_EX_OP
	select PINCTRL
	select USE_RA_FSP_OSPI_B_NOR_FLASH
	help
	  Enable the conservative first-version W25Q64 driver for the Titan Board
	  Mini onboard 8 MiB SPI NOR flash wired to RA8P1 OSPI_B CS1.

endmenu
```

## src/drivers/video/renesas_ra_mipi/Kconfig
```kconfig
# SPDX-License-Identifier: Apache-2.0

config VIDEO_TITAN_RA_MIPI_CSI
	bool "Titan Board Mini RA8P1 MIPI CSI/VIN video capture"
	depends on VIDEO && HAS_RENESAS_RA_FSP
	select VIDEO_OV5640
	help
	  Enable the Titan Board Mini RA8P1 MIPI CSI-2 plus VIN capture bridge.
	  This driver connects the upstream OV5640 sensor driver to Zephyr's video
	  buffer API so USB UVC can consume captured frames.

config VIDEO_TITAN_RA_MIPI_CSI_INIT_PRIORITY
	int "Titan RA MIPI CSI/VIN init priority"
	default 61
	depends on VIDEO_TITAN_RA_MIPI_CSI
	help
	  Must run after the OV5640 sensor driver, which defaults to
	  CONFIG_VIDEO_INIT_PRIORITY.
```

## src/dts/bindings/flash_controller/titan,w25q64-ra-ospi-b.yaml
```yaml
# Copyright (c) 2026 RT-Thread
# SPDX-License-Identifier: Apache-2.0

description: Winbond W25Q64 SPI NOR flash on Titan Board Mini RA OSPI_B CS1

compatible: "titan,w25q64-ra-ospi-b"

include: [flash-controller.yaml]

on-bus: ospi

properties:
  reg:
    required: true
    description: Memory-mapped base address and flash size in bytes.

  jedec-id:
    type: uint8-array
    required: true
    description: Expected three-byte JEDEC ID. W25Q64JV is ef 40 17.

  spi-max-frequency:
    type: int
    required: true
    description: Maximum allowed OSPI_B clock frequency in Hz for conservative 1S-1S-1S mode.

  page-size:
    type: int
    required: true
    description: Page program size in bytes. W25Q64 uses 256-byte pages.

  erase-block-size:
    type: int
    required: true
    description: Erase granularity exposed by this driver. First version supports 4 KiB sectors.

  write-block-size:
    type: int
    required: true
    description: Minimum write alignment exposed through flash_parameters.
```

## src/dts/bindings/video/titan,ra8p1-mipi-csi-vin.yaml
```yaml
# Copyright (c) 2026 RT-Thread
# SPDX-License-Identifier: Apache-2.0

description: Titan Board Mini RA8P1 MIPI CSI-2 receiver with VIN capture

compatible: "titan,ra8p1-mipi-csi-vin"

include: base.yaml

properties:
  interrupts:
    required: true

  interrupt-names:
    required: true

child-binding:
  child-binding:
    include: video-interfaces.yaml

    properties:
      bus-type:
        required: true
      data-lanes:
        required: true
```
